/ {
    behaviors {
        /omit-if-no-ref/ pmw3610_inertia_toggle: pmw3610_inertia_toggle {
            compatible = "zmk,behavior-pmw3610-inertia-toggle";
            #binding-cells = <0>;
            label = "PMW3610_INERTIA_TOGGLE";
            display-name = "PMW3610 Inertia Toggle";
        };
    };
};
