## Kconfig
```kconfig
# Sensor data simulator
#
# Copyright (c) 2019 Nordic Semiconductor
#
# SPDX-License-Identifier: LicenseRef-Nordic-5-Clause
#

menuconfig PMW3610
  bool "PMW3610 mouse optical sensor"
  select SPI
  depends on INPUT
  depends on DT_HAS_PIXART_PMW3610_ENABLED
  help
      Enable PMW3610 mouse optical sensor.

if PMW3610

config INPUT_PMW3610_INIT_PRIORITY
    int "PMW3610 initialization priority"
    default INPUT_INIT_PRIORITY

config PMW3610_SWAP_XY
  bool "Swap the X/Y axis of PMW3610 sensor"

config PMW3610_INVERT_X
  bool "Invert the X axis of PMW3610 sensor"

config PMW3610_INVERT_Y
  bool "Invert the Y axis of PMW3610 sensor"

config PMW3610_INIT_POWER_UP_EXTRA_DELAY_MS
  int "Extra power up init delay (ms)"
  default 0
  help
    Default minimum init power up delay is 10ms.
    Use this config to postpone init power up sequence if needs longer bootup time.

config PMW3610_INIT_RETRY_BACKOFF_MS
  int "Delay after an exhausted PMW3610 initialization retry burst (ms)"
  default 1000
  range 100 10000
  help
    Delay before restarting the full sensor initialization sequence after
    three retries have been exhausted. The retry runs asynchronously, so
    keyboard input remains available while the sensor recovers.

config PMW3610_RECOVERY_DELAY_MS
  int "Delay before runtime PMW3610 recovery (ms)"
  default 20
  range 10 500
  help
    Delay before restarting the sensor after a runtime SPI, FAULT, or IRQ
    failure. This is intentionally shorter than the startup retry backoff.

config PMW3610_STUCK_IRQ_TIME_MS
  int "Time before treating an active IRQ without MOT as stuck (ms)"
  default 20
  range 5 500

config PMW3610_INPUT_RETRY_TIMEOUT_MS
  int "Maximum time to retain undelivered motion (ms)"
  default 50
  range 5 500
  help
    Drop undelivered motion after this period so input congestion cannot
    produce a large delayed pointer jump.

config PMW3610_WORKQUEUE_STACK_SIZE
  int "PMW3610 work queue stack size"
  default 1536
  range 1024 4096

config PMW3610_WORKQUEUE_PRIORITY
  int "PMW3610 work queue priority"
  default 10
  range 0 14
  help
    Preemptible priority for PMW3610 processing. Keeping this below the input
    consumer prevents the sensor producer from starving a congested queue.

config PMW3610_INPUT_REPORT_TIMEOUT_MS
  int "Maximum PMW3610 input queue wait (ms)"
  default 0
  range 0 20
  help
    Maximum time the driver waits for each input event to enter Zephyr's input
    queue. Zero uses non-blocking delivery. Failed reports are retried for a
    short bounded period on the dedicated PMW3610 work queue.

config PMW3610_REPORT_INTERVAL_MIN
	int "PMW3610's default minimum report rate"
	default 0
	help
	  Default minimum report interval in milliseconds.
		Slow down input reporting for hid queue over the air.
		Turn value down to 8ms to get sharp response if use with USB only.

config PMW3610_SMART_ALGORITHM
  bool "Enable an algorithm of PMW3610 to enhance surface coverage"
  default y
  help
    Enable the integration of the smart algorithm as the datasheet implementation.
    The algorithm is used to extend the tracking acrocss a wider range of surfaces
    such as graniles and tiles.

config PMW3610_RUN_DOWNSHIFT_TIME_MS
    int "PMW3610's default RUN mode downshift time"
    default 128
    range 32 3264
    help
      Default RUN mode downshift down time in milliseconds.
      Time after which sensor goes from RUN to REST1 mode.

config PMW3610_REST1_DOWNSHIFT_TIME_MS
    int "PMW3610's default REST1 mode downshift time"
    default 5000
    help
      Default REST1 mode downshift down time in milliseconds.
      Time after which sensor goes from REST1 to REST2 mode.

config PMW3610_REST2_DOWNSHIFT_TIME_MS
    int "PMW3610's default REST2 mode downshift time"
    default 17000
    help
      Default REST2 mode downshift down time in milliseconds.
      Time after which sensor goes from REST2 to REST3 mode.

config PMW3610_REST1_SAMPLE_TIME_MS
    int "PMW3610's sample time in REST1 stage"
    default 40
    # range 10 2550
    help
      Default REST1 mode sample period in millisecond

config PMW3610_REST2_SAMPLE_TIME_MS
    int "PMW3610's sample time in REST2 stage"
    default 100
    # range 10 2550
    help
      Default REST2 mode sample period in millisecond.

config PMW3610_REST3_SAMPLE_TIME_MS
    int "PMW3610's sample time in REST3 stage"
    default 500
    # range 10 2550
    help
      Default REST2 mode sample period in millisecond.

module = PMW3610
module-str = PMW3610
source "${ZEPHYR_BASE}/subsys/logging/Kconfig.template.log_config"

endif #PMW3610
```

## dts/bindings/behaviors/zmk,behavior-pmw3610-horizontal-scroll-direction-toggle.yaml
```yaml
# Copyright (c) 2026 The ZMK Contributors
# SPDX-License-Identifier: MIT

description: PMW3610 horizontal scroll direction toggle behavior

compatible: "zmk,behavior-pmw3610-horizontal-scroll-direction-toggle"

include: zero_param.yaml
```

## dts/bindings/behaviors/zmk,behavior-pmw3610-inertia-toggle.yaml
```yaml
# Copyright (c) 2026 The ZMK Contributors
# SPDX-License-Identifier: MIT

description: PMW3610 inertial scroll toggle behavior

compatible: "zmk,behavior-pmw3610-inertia-toggle"

include: zero_param.yaml
```

## dts/bindings/behaviors/zmk,behavior-pmw3610-scroll-direction-toggle.yaml
```yaml
# Copyright (c) 2026 The ZMK Contributors
# SPDX-License-Identifier: MIT

description: PMW3610 vertical scroll direction toggle behavior

compatible: "zmk,behavior-pmw3610-scroll-direction-toggle"

include: zero_param.yaml
```

## dts/bindings/pixart,pmw3610.yml
```yaml
description: |
  Sensor driver for the pixart PMW3610 mouse sensor 

compatible: "pixart,pmw3610"

include: spi-device.yaml

properties:
  irq-gpios:
    type: phandle-array
    required: true
  cpi:
    type: int
    default: 600
    description: "CPI value (Range: 200 - 3200, Step: 200)"
  motion-threshold:
    type: int
    default: 1
    description: |
      Ignore X/Y motion deltas whose absolute values are both at or below this
      threshold. Set to 0 to disable drift filtering.
  max-motion-delta:
    type: int
    default: 512
    description: |
      Reject a single motion sample when either axis reaches this absolute
      value. This prevents corrupted-but-successful SPI samples from producing
      a pointer jump or seeding inertial scrolling.
  max-report-delta:
    type: int
    default: 2047
    description: |
      Maximum absolute X/Y delta emitted in one input report after samples
      have been accumulated. Excess motion is discarded instead of being
      released in later reports as a delayed cursor or scroll jump.
  low-speed-stabilizer:
    type: boolean
    description: |
      Stabilize low-speed pointer motion without discarding distance. Repeated
      same-direction micro motion is emitted, while isolated direction
      reversals are held for confirmation and cancelled when they bounce back.
  low-speed-stabilizer-threshold:
    type: int
    default: 1
    description: "Largest absolute delta treated as micro motion."
  low-speed-stabilizer-timeout-ms:
    type: int
    default: 30
    description: "Idle time after which micro-motion direction history is reset."
  swap-xy:
    type: boolean
  invert-x:
    type: boolean
  invert-y:
    type: boolean
  evt-type:
    type: int
    required: true
  x-input-code:
    type: int
    required: true
  y-input-code:
    type: int
    required: true
  force-awake:
    type: boolean
  force-awake-4ms-mode:
    type: boolean
  inertial-scroll:
    type: boolean
    description: "Enable inertial scrolling when this sensor is configured as a scroll device."
  scroll-direction-toggle:
    type: boolean
    description: "Allow the scroll direction toggle behaviors to affect this sensor even when inertial-scroll is disabled."
  inertial-scroll-decay-pct:
    type: int
    default: 99
    description: "Velocity decay percentage applied on each inertial tick."
  inertial-scroll-decay-basis-points:
    type: int
    default: 0
    description: "Optional velocity retention in 0.01 percent units; zero uses inertial-scroll-decay-pct."
  inertial-scroll-interval-ms:
    type: int
    default: 10
    description: "Interval in milliseconds for synthetic inertial scroll reports."
  inertial-scroll-threshold:
    type: int
    default: 4
    description: "Minimum fixed-point velocity threshold before inertial scrolling stops."
  inertial-scroll-gain-pct:
    type: int
    default: 130
    description: "Gain percentage used to derive inertial velocity from the latest physical scroll delta."
  inertial-scroll-max-velocity:
    type: int
    default: 32
    description: "Maximum inertial output velocity in whole scroll steps per tick."
  inertial-scroll-max-duration-ms:
    type: int
    default: 1800
    description: "Maximum duration in milliseconds of one inertial tail."
  inertial-scroll-fade-duration-ms:
    type: int
    default: 250
    description: "Duration of the linear fade applied before the inertial maximum duration is reached."
  inertial-scroll-layers:
    type: array
    description: "List of active ZMK layer numbers where inertial scrolling is allowed. Omit this property to allow all layers."
  vertical-scroll-uses-x-axis:
    type: boolean
    description: "Treat the sensor X axis as vertical and Y as horizontal for direction toggling. Use for sensors mounted with a 90-degree rotation."
```
